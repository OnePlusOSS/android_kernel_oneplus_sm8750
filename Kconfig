## Kconfig
```kconfig
# SPDX-License-Identifier: GPL-2.0
#
# For a description of the syntax of this configuration file,
# see Documentation/kbuild/kconfig-language.rst.
#
mainmenu "Linux/$(ARCH) $(KERNELVERSION) Kernel Configuration"

config OPLUS_SYSTEM_KERNEL_QCOM
  bool "config oplus system feature "
  default y
  help
	define this config to Distinguish between qcom and mtk platform

source "scripts/Kconfig.include"

source "init/Kconfig"

source "kernel/Kconfig.freezer"

source "fs/Kconfig.binfmt"

source "mm/Kconfig"

source "net/Kconfig"

source "drivers/Kconfig"

source "fs/Kconfig"

source "security/Kconfig"

source "crypto/Kconfig"

source "lib/Kconfig"

source "lib/Kconfig.debug"

source "Documentation/Kconfig"

# ANDROID: Set KCONFIG_EXT_PREFIX to decend into an external project.
source "$(KCONFIG_EXT_PREFIX)Kconfig.ext"

source "kernel/sched/walt/Kconfig"

source "drivers/oplus_inject/Kconfig"
```

## arch/arm64/configs/oplus_debug_defconfig
```kconfig
CONFIG_KCOV=y
CONFIG_KCOV_ENABLE_COMPARISONS=y

# CONFIG_MODULE_SIG_PROTECT is not set

# CONFIG_ATOMIC64_SELFTEST is not set
# CONFIG_BACKTRACE_SELF_TEST is not set
# CONFIG_BITFIELD_KUNIT is not set
# CONFIG_BITS_TEST is not set
CONFIG_BOOTPARAM_SOFTLOCKUP_PANIC=y
CONFIG_DEBUG_ATOMIC_SLEEP=y
CONFIG_DEBUG_IRQFLAGS=y
CONFIG_DEBUG_KMEMLEAK=y
# CONFIG_DEBUG_KMEMLEAK_AUTO_SCAN is not set
CONFIG_DEBUG_KMEMLEAK_DEFAULT_OFF=y
CONFIG_DEBUG_KMEMLEAK_MEM_POOL_SIZE=16000
# CONFIG_DEBUG_KMEMLEAK_TEST is not set
# CONFIG_DEBUG_KOBJECT_RELEASE is not set
CONFIG_PROVE_LOCKING=y
CONFIG_LOCKDEP_CHAINS_BITS=19
CONFIG_LOCKDEP_BITS=18
CONFIG_LOCKDEP_STACK_TRACE_BITS=20
CONFIG_DEBUG_LOCKDEP=y
CONFIG_DEBUG_LOCK_ALLOC=y
CONFIG_DEBUG_MUTEXES=y
CONFIG_DEBUG_OBJECTS=y
CONFIG_DEBUG_OBJECTS_ENABLE_DEFAULT=1
# CONFIG_DEBUG_OBJECTS_FREE is not set
# CONFIG_DEBUG_OBJECTS_PERCPU_COUNTER is not set
# CONFIG_DEBUG_OBJECTS_RCU_HEAD is not set
# CONFIG_DEBUG_OBJECTS_SELFTEST is not set
CONFIG_DEBUG_OBJECTS_TIMERS=y
CONFIG_DEBUG_OBJECTS_WORK=y
CONFIG_DEBUG_PREEMPT=y
CONFIG_DEBUG_RT_MUTEXES=y
CONFIG_DEBUG_RWSEMS=y
CONFIG_DEBUG_SPINLOCK=y
# CONFIG_DPM_WATCHDOG is not set
CONFIG_DYNAMIC_DEBUG=y
# CONFIG_FIND_BIT_BENCHMARK is not set
# CONFIG_INTERVAL_TREE_TEST is not set
# CONFIG_KPROBES_SANITY_TEST is not set
# CONFIG_LINEAR_RANGES_TEST is not set
# CONFIG_LIST_KUNIT_TEST is not set
# CONFIG_LKDTM is not set
CONFIG_LOCALVERSION="-oplus-debug"
CONFIG_LOCKDEP=y
CONFIG_LOCKUP_DETECTOR=y
CONFIG_LOCK_STAT=y
# CONFIG_PERCPU_TEST is not set
CONFIG_PID_IN_CONTEXTIDR=y
# CONFIG_PM_ADVANCED_DEBUG is not set
CONFIG_PM_DEBUG=y
CONFIG_PM_SLEEP_DEBUG=y
# CONFIG_PM_TEST_SUSPEND is not set
# CONFIG_RBTREE_TEST is not set
# CONFIG_REED_SOLOMON_TEST is not set
CONFIG_RUNTIME_TESTING_MENU=y
CONFIG_SOFTLOCKUP_DETECTOR=y
# CONFIG_SYSCTL_KUNIT_TEST is not set
```

## drivers/oplus_inject/Kconfig
```kconfig
# SPDX-License-Identifier: GPL-2.0
# Used to set environment variables during compilation to dynamically enable certain compilation functions:
# compilation or not compilation of modules
# conditional compilation of C language files
# Configuration settings for data injection and fault injection code
# In Kconfig, we have made the following conventions:
# All configurations should start with OPLUS_FEATURE_
# All configurations should default to n, and the defconfig file determines whether to enable it.
# For compatibility, all configurations should be tristate, although it only be configured as y/n
# 用于在编译时设置环境变量来动态开启某些编译功能：针对模块的编译或不编译; 针对C代码的条件编译
# 为数据注入及故障注入代码设置的配置
# 在 Kconfig 中，我们作了如下约定：
# 所有的配置，应当以 OPLUS_FEATURE_ 打头
# 所有的配置，应该默认为 n, 由 defconfig 文件来决定是否使能
# 为了兼容性设计，所有的配置，应该是 tristate, 虽然他可能只被配置为 y/n
# 80353364
# 2023-12-29

config OPLUS_FEATURE_BSP_DRV_INJECT_TEST
	tristate "data and fault inject test switch"
	default n
	help
	  data and fault inject test switch

config OPLUS_FEATURE_BSP_DRV_VND_INJECT_TEST
	tristate "data and fault inject test vendor switch"
	default n
	help
	  data and fault inject test switch

config OPLUS_FEATURE_BSP_DRV_SENSOR_INJECT
	tristate "sensor data inject test switch"
	default n
	help
	  sensor data inject test switch
```

## drivers/power/Kconfig
```kconfig
# SPDX-License-Identifier: GPL-2.0-only
source "drivers/power/reset/Kconfig"
source "drivers/power/supply/Kconfig"
#ifdef OPLUS_FEATURE_CHG_BASIC
source "drivers/power/oplus/Kconfig"
#endif
```

## drivers/soc/Kconfig
```kconfig
# SPDX-License-Identifier: GPL-2.0-only
menu "SOC (System On Chip) specific Drivers"

source "drivers/soc/actions/Kconfig"
source "drivers/soc/amlogic/Kconfig"
source "drivers/soc/apple/Kconfig"
source "drivers/soc/aspeed/Kconfig"
source "drivers/soc/atmel/Kconfig"
source "drivers/soc/bcm/Kconfig"
source "drivers/soc/canaan/Kconfig"
source "drivers/soc/fsl/Kconfig"
source "drivers/soc/fujitsu/Kconfig"
source "drivers/soc/hisilicon/Kconfig"
source "drivers/soc/imx/Kconfig"
source "drivers/soc/ixp4xx/Kconfig"
source "drivers/soc/litex/Kconfig"
source "drivers/soc/loongson/Kconfig"
source "drivers/soc/mediatek/Kconfig"
source "drivers/soc/microchip/Kconfig"
source "drivers/soc/nuvoton/Kconfig"
source "drivers/soc/pxa/Kconfig"
source "drivers/soc/qcom/Kconfig"
source "drivers/soc/renesas/Kconfig"
source "drivers/soc/rockchip/Kconfig"
source "drivers/soc/samsung/Kconfig"
source "drivers/soc/sifive/Kconfig"
source "drivers/soc/starfive/Kconfig"
source "drivers/soc/sunxi/Kconfig"
source "drivers/soc/tegra/Kconfig"
source "drivers/soc/ti/Kconfig"
source "drivers/soc/ux500/Kconfig"
source "drivers/soc/versatile/Kconfig"
source "drivers/soc/xilinx/Kconfig"

#ifdef OPLUS_FEATURE_MM_FEEDBACK
source "drivers/soc/oplus/multimedia/Kconfig"
#endif /* OPLUS_FEATURE_MM_FEEDBACK */

#ifdef OPLUS_TRACKPOINT_REPORT
source "drivers/soc/oplus/trackpoint/Kconfig"
#endif /* OPLUS_TRACKPOINT_REPORT */

#ifdef OPLUS_FEATURE_BOOT
source "drivers/soc/oplus/boot/Kconfig"
#endif /* OPLUS_FEATURE_BOOT */


#ifdef OPLUS_FEATURE_MODEM_MINIDUMP
source "drivers/soc/oplus/mdmrst/Kconfig"
#endif /*OPLUS_FEATURE_MODEM_MINIDUMP*/

#ifdef OPLUS_FEATURE_TP_BASIC
source "drivers/soc/oplus/device_info/Kconfig"
#endif /* OPLUS_FEATURE_TP_BASIC */
#ifdef OPLUS_FEATURE_QCOM_WATCHDOG
source "drivers/soc/oplus/boot/qcom_watchdog/Kconfig"
#endif

#ifdef OPLUS_UFS_DRIVER
source "drivers/soc/oplus/storage/common/ufs_oplus_dbg/Kconfig"
source "drivers/soc/oplus/storage/common/oplus_uprobe/Kconfig"
source "drivers/soc/oplus/storage/common/storage_log/Kconfig"
source "drivers/soc/oplus/storage/common/oplus_f2fslog_storage/Kconfig"
source "drivers/soc/oplus/storage/common/wq_dynamic_priority/Kconfig"
#endif

#ifdef CONFIG_OPLUS_FEATURE_STORAGE_IO_METRICS
source "drivers/soc/oplus/storage/common/io_metrics/Kconfig"
#endif

#ifdef OPLUS_FEATURE_DFT
source "drivers/soc/oplus/dft/Kconfig"
#endif /* OPLUS_FEATURE_DFT */

#ifdef OPLUS_SUBSYS_SLEEP_MONITOR
source "drivers/soc/oplus/power/subsys_sleep_monitor/Kconfig"
#endif /* OPLUS_SUBSYS_SLEEP_MONITOR */

#ifdef OPLUS_FEATURE_WAKER_IDENTIFY
source "kernel/oplus_cpu/waker_identify/Kconfig"
#endif /* OPLUS_FEATURE_WAKER_IDENTIFY */

#ifdef OPLUS_FEATURE_FPGA
source "drivers/soc/oplus/fpga_notify/Kconfig"
#endif /* OPLUS_FEATURE_FPGA */
endmenu
```
